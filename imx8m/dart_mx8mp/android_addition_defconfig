## imx8m/dart_mx8mp/android_gki_defconfig
```kconfig
CONFIG_ARCH_MXC=y
CONFIG_CLK_IMX8MP=y
CONFIG_DEVICE_THERMAL=m
CONFIG_IMX8MM_THERMAL=m
# CONFIG_DEVFREQ_THERMAL is not set
CONFIG_IMX8M_PM_DOMAINS=m
CONFIG_PINCTRL_IMX=y
CONFIG_PINCTRL_IMX8MP=y
CONFIG_SERIAL_IMX=y
CONFIG_SERIAL_IMX_CONSOLE=y
CONFIG_IMX2_WDT=m
CONFIG_I2C_IMX=m
CONFIG_MFD_PCA9450=m
CONFIG_REGULATOR_PCA9450=m
CONFIG_PWM_IMX27=m
CONFIG_BACKLIGHT_PWM=m
CONFIG_MMC_SDHCI_ESDHC_IMX=m
CONFIG_ION_CMA_HEAP=m
CONFIG_MFD_IMX_AUDIOMIX=m
CONFIG_PHY_FSL_IMX8MP_LVDS=m
CONFIG_PHY_SAMSUNG_HDMI_PHY=m
CONFIG_MXC_GPU_VIV=m
CONFIG_IMX_LCDIF_CORE=m
CONFIG_DRM_I2C_ADV7511=m
CONFIG_DRM_IMX_CDNS_MHDP=m
CONFIG_DRM_IMX8MP_LDB=m
CONFIG_DRM_FSL_IMX_LVDS_BRIDGE=m
CONFIG_DRM_ITE_IT6263=m
CONFIG_DRM_IMX_SEC_DSIM=m
CONFIG_DRM_DW_HDMI_CEC=m
CONFIG_DRM_DW_HDMI_GP_AUDIO=m
CONFIG_DRM_IMX_HDMI=m
CONFIG_DRM_IMX=m
#CONFIG_DRM_PANEL_RAYDIUM_RM67191=m
CONFIG_DRM_PANEL_SIMPLE=m
CONFIG_IMX_LCDIFV3_CORE=m
CONFIG_PHY_FSL_IMX8MQ_USB=m
CONFIG_USB_DWC3=m
CONFIG_MEDIA_USB_SUPPORT=y
CONFIG_USB_VIDEO_CLASS=y
CONFIG_USB_XHCI_HCD=m
CONFIG_TYPEC_SWITCH_GPIO=m
CONFIG_TYPEC_TCPCI=m

CONFIG_IMX_SDMA=m
CONFIG_SND_IMX_SOC=m
CONFIG_SND_SOC_IMX_MICFIL=m
CONFIG_SND_SOC_FSL_EASRC=m
CONFIG_SND_SOC_IMX_CDNHDMI=m
CONFIG_SND_SOC_IMX_WM8960=m
CONFIG_SND_SOC_BT_SCO=m
CONFIG_SND_SIMPLE_CARD=m
CONFIG_SND_SOC_FSL_DSP=m
CONFIG_SND_VERBOSE_PROCFS=y

CONFIG_IMX_MBOX=m
CONFIG_I2C_RPBUS=m
CONFIG_SND_SOC_IMX_RPMSG=m
CONFIG_IMX_REMOTEPROC=m

CONFIG_RTC_DRV_SNVS=m

CONFIG_WLAN_VENDOR_NXP=m
CONFIG_MXMWIFIEX=m
CONFIG_TOUCHSCREEN_SYNAPTICS_DSX_I2C=y
CONFIG_KEYBOARD_SNVS_PWRKEY=m
# CONFIG_MXC_VPU_MALONE is not set
# CONFIG_MXC_VPU_WINDSOR is not set
# CONFIG_MXC_IMX_DMX_HW is not set

CONFIG_PHY_FSL_IMX_PCIE=m
CONFIG_PCI_IMX6=m

CONFIG_STAGING_MEDIA=y
CONFIG_VIDEO_OV5640=m
CONFIG_VIDEO_IMX_CAPTURE=m

CONFIG_NET_VENDOR_FREESCALE=y
CONFIG_ETHERNET=y
CONFIG_FEC=m

CONFIG_TRUSTY=m

CONFIG_MXC_HANTRO_VC8000E=m
CONFIG_MXC_HANTRO_845=m

CONFIG_BATTERY_DUMMY=m

CONFIG_RESET_IMX7=m
CONFIG_RESET_IMX_HDMIMIX=m
CONFIG_RESET_IMX_AUDIOMIX=m
CONFIG_IMX8M_BUSFREQ=y
CONFIG_IMX_IRQSTEER=y
CONFIG_GPIO_MXC=m
CONFIG_TIMER_IMX_SYS_CTR=y

CONFIG_FPGA=y
CONFIG_INIT_STACK_NONE=y

CONFIG_NVMEM_IMX_OCOTP=m
CONFIG_CPUFREQ_DT=m
CONFIG_ARM_IMX_CPUFREQ_DT=m


CONFIG_DRM_I2C_SN65DSI83=y
CONFIG_REGULATOR_TPS62360=y
CONFIG_DRM_PANEL_LVDS=y
CONFIG_DRM_DW_HDMI_I2S_AUDIO=y
CONFIG_SND_SOC_FSL_DAI=y
CONFIG_SND_SOC_FSL_ACM=y
CONFIG_SND_SOC_FSL_ASOC_CARD=y
CONFIG_SND_SOC_WM8904=y
CONFIG_IMX_DMA=y
CONFIG_EXTCON_PTN5150=y
CONFIG_SDCARD_FS=y
CONFIG_CRYPTO_DEV_FSL_CAAM_SECVIO=y
CONFIG_CMDLINE_EXTEND_BOOTLOADER=y
CONFIG_RFKILL_INPUT=y
CONFIG_RFKILL_GPIO=y


CONFIG_MXC_CLK_SCU=y
CONFIG_CLK_IMX8MQ=y
CONFIG_TOUCHSCREEN_EDT_FT5X06=y
CONFIG_GPIO_PCA953X=y
CONFIG_CONSOLE_TRANSLATIONS=y
CONFIG_MFD_SEC_CORE=y

CONFIG_REGULATOR_PFUZE100=y

CONFIG_REGULATOR_PWM=y

CONFIG_PSTORE_PMSG=y
CONFIG_CGROUP_HUGETLB=y
CONFIG_SYSFS_SYSCALL=y

CONFIG_GPIO_PCA953X_IRQ=y

CONFIG_DRM_MALI_DISPLAY=m

CONFIG_FSL_EDMA=y
CONFIG_FSL_EDMA_V3=y
CONFIG_IMX_DMA=y

CONFIG_SND_SOC_IMX_PCM_DMA=y


CONFIG_FRAMEBUFFER_CONSOLE=y
CONFIG_FRAMEBUFFER_CONSOLE_DETECT_PRIMARY=y
CONFIG_LOGO=y
CONFIG_LOGO_LINUX_CLUT224=y
CONFIG_LOGO_VARISCITE_CLUT224=y
CONFIG_DMIID=y
```

## imx8m/dart_mx8mq/android_addition_defconfig
```kconfig
CONFIG_MXC_HANTRO=m
CONFIG_MXC_HANTRO_845=m
CONFIG_MXC_HANTRO_845_H1=m
CONFIG_MXC_HANTRO_VC8000E=m
```
